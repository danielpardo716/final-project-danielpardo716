## base_external/Config.in
```kconfig
source "$BR2_EXTERNAL_final_project_base_PATH/package/aesd-final-project/Config.in"
```

## base_external/package/aesd-final-project/Config.in
```kconfig
config BR2_PACKAGE_AESD_FINAL_PROJECT
	bool "aesd-final-project"
	select BR2_PACKAGE_LIBGPIOD
	help
	  Includes the LED blinky and temperature sensor driver for the AESD final project.
```

## layers/meta-sensor-node/conf/layer.conf
```bitbake
# We have a conf and classes directory, add to BBPATH
BBPATH .= ":${LAYERDIR}"

# We have recipes-* directories, add to BBFILES
BBFILES += "${LAYERDIR}/recipes-*/*/*.bb \
            ${LAYERDIR}/recipes-*/*/*.bbappend"

BBFILE_COLLECTIONS += "meta-sensor-node"
BBFILE_PATTERN_meta-sensor-node = "^${LAYERDIR}/"
BBFILE_PRIORITY_meta-sensor-node = "6"

LAYERDEPENDS_meta-sensor-node = "core"
LAYERSERIES_COMPAT_meta-sensor-node = "hardknott kirkstone"
```
